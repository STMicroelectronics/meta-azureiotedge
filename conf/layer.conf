## conf/layer.conf
```bitbake
# We have a conf and classes directory, add to BBPATH
BBPATH .= ":${LAYERDIR}"

# We have recipes-* directories, add to BBFILES
BBFILES += "${LAYERDIR}/recipes-*/*.bb \
            ${LAYERDIR}/recipes-*/*.bbappend \
"

BBFILE_COLLECTIONS += "azureiotedge"
BBFILE_PATTERN_azureiotedge = "^${LAYERDIR}/"
BBFILE_PRIORITY_azureiotedge = "5"

#LAYERDEPENDS_azureiotedge = "meta-python"
LAYERDEPENDS_azureiotedge = "qt5-layer"

# Set a variable to get the openstlinux location
OPENSTLINUX_BASE = "${LAYERDIR}"

# This should only be incremented on significant changes that will
# cause compatibility issues with other layers
LAYERVERSION_azureiotedge = "1"
LAYERSERIES_COMPAT_azureiotedge = "thud"

DISTRO_FEATURES_append += " \
	systemd \
	virtualization \
"

IMAGE_INSTALL_append = " \
	python-pip \
	python-dev \
	python3-pip \
	python3-dev \
	python-enum34 \
	python-futures \
	glib-2.0-dev \
	packagegroup-core-buildessential \
	vim \
	git \
	sqlite3 \
	ca-certificates \
	libffi-dev \
	docker \
	docker-contrib \
	connman \
	connman-client \
	iotedge-daemon \
	iotedge-cli \
	libiothsm-std \
"

VIRTUAL-RUNTIME_init_manager = "systemd"
VIRTUAL-RUNTIME_initscripts = "systemd-compat-units"
```
